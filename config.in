## config.in
```kconfig
#
# TLVC Main
#

mainmenu_name "TLVC Main"

#
# TLVC Kernel
#

mainmenu_option next_comment
	comment 'Kernel & Hardware'
	source tlvc/config.in

endmenu

#
# TLVC Userland (commands)
#

source tlvccmd/config.in

#
# TLVC Images
#

source image/config.in
```

## tlvc/arch/i86/drivers/block/config.in
```kconfig
# Block device driver configuration
#
mainmenu_option next_comment
    comment 'Block device drivers'
    comment 'Choose either BIOS devices or Direct devices.'
    Comment 'To choose one, deselect the other!'

    bool 'DIRECT drivers' CONFIG_BLK_DEV_DIRECT y
    if [ "$CONFIG_BLK_DEV_DIRECT" == "y" ]; then
	define_bool CONFIG_BLK_DEV_BIOS n
	define_bool CONFIG_BLK_DEV_BFD n
	define_bool CONFIG_BLK_DEV_BHD n
	bool '  Native floppy support'		CONFIG_BLK_DEV_FD	y
	bool '  Native IDE hardisk support'	CONFIG_BLK_DEV_HD	y
	if [ "$CONFIG_BLK_DEV_HD" == "y" ]; then
	    bool '  Include XT-IDE/CF support'	CONFIG_XT_IDE		n
	fi
	bool '  XT/MFM disk support'	CONFIG_BLK_DEV_XD	n
    fi
    bool 'BIOS based drivers' CONFIG_BLK_DEV_BIOS n
    if [ "$CONFIG_BLK_DEV_BIOS" == "y" ]; then
	bool '  BIOS floppy support'	CONFIG_BLK_DEV_BFD	n
	bool '  BIOS harddisk support'	CONFIG_BLK_DEV_BHD	n
	bool '  IDE harddisk CHS probe'	CONFIG_IDE_PROBE	n
    fi
    if [ "$CONFIG_BLK_DEV_FD" == "y" -o "$CONFIG_BLK_DEV_XD" == "y" -o "$CONFIG_ETH_LANCE" == "y" ]; then
	define_bool CONFIG_DMA y
    else
	define_bool CONFIG_DMA n
    fi
    int 'Floppy drive sector cache, 1-7KB, 0 to disable' \
	    CONFIG_FLOPPY_CACHE 5

    comment 'Additional block devices'
	bool 'RAM disk support'			CONFIG_BLK_DEV_RAM	y
	if [ "$CONFIG_BLK_DEV_RAM" == "y" ]; then
		hex 'Preload RAM disk segment address' CONFIG_RAMDISK_SEGMENT 0
		int 'Preload RAM disk sectors' CONFIG_RAMDISK_SECTORS 128
	fi
	choice 'SSD disk driver' \
		"None CONFIG_BLK_DEV_SSD_NONE \
		ssd_test CONFIG_BLK_DEV_SSD_TEST \
		ssd_sd_8018x CONFIG_BLK_DEV_SSD_SD8018X " None

endmenu
```
